## conf/distro/common.inc
```bitbake
# The bundle version interacts with the downgrade barrier.
# "r0" as version, disables the downgrade barrier. If a
# downgrade barrier is set with r1, you have to increase
# the version for every update. In that way old security
# vulnerabilities cannot be exploited.
RAUC_BUNDLE_VERSION ?= "r0"

#Overrides depend on Distro Features
OVERRIDES_append = "${@bb.utils.contains('DISTRO_FEATURES','secureboot',':secureboot', '',d)}"
PROTECTION_SHIELD_LEVEL ??= "shieldlow"
OVERRIDES_append = "${@bb.utils.contains('DISTRO_FEATURES','protectionshield',':${PROTECTION_SHIELD_LEVEL}', '',d)}"

VIRTUAL-RUNTIME_dev_manager = "udev"
VIRTUAL-RUNTIME_init_manager = "systemd"
VIRTUAL-RUNTIME_login_manager = "busybox"
VIRTUAL-RUNTIME_syslog = "rsyslog"
VIRTUAL-RUNTIME_initscripts = ""

VIRTUAL-RUNTIME_update-alternatives ?= "apt-utils"
VIRTUAL-RUNTIME_base-utils ?= "busybox"
VIRTUAL-RUNTIME_base-utils-hwclock ?= "util-linux"
VIRTUAL-RUNTIME_base-utils-syslog ?= "systemd"

POKY_DEFAULT_DISTRO_FEATURES = "largefile opengl ptest multiarch wayland vulkan"

DISTRO_FEATURES_LIBC_mx6ul ?= "ipv4 ipv6 libc-backtrace libc-big-macros libc-bsd libc-cxx-tests libc-catgets libc-charsets libc-crypt \
                               libc-crypt-ufc libc-db-aliases libc-envz libc-fcvt libc-fmtmsg libc-fstab libc-ftraverse \
                               libc-getlogin libc-idn libc-inet-anl libc-libm libc-locales libc-locale-code \
                               libc-memusage libc-nis libc-nsswitch libc-rcmd libc-rtld-debug libc-spawn libc-streams libc-sunrpc \
                               libc-utmp libc-utmpx libc-wordexp libc-posix-clang-wchar libc-posix-regexp libc-posix-regexp-glibc \
                               libc-posix-wchar-io"

DISTRO_FEATURES_DEFAULT ?= "acl alsa argp bluetooth ext2 ipv4 ipv6 irda largefile pcmcia usbgadget usbhost wifi xattr nfs zeroconf pci 3g nfc x11"

DISTRO_FEATURES ?= "${DISTRO_FEATURES_DEFAULT} ${DISTRO_FEATURES_LIBC} ${POKY_DEFAULT_DISTRO_FEATURES}"

python __anonymous() {
    val1 = set(d.getVar('DISTRO_FEATURES').split())
    val2 = set(d.getVar('MACHINE_FEATURES').split())
    d.setVar('COMBINED_FEATURES', " ".join(val1 & val2))
}
```

## conf/distro/phybian-vendor-xwayland.conf
```bitbake
require phybian-vendor.conf

DISTRO = "phybian-vendor-xwayland-bullseye"
DISTRO_NAME = "phyBIAN Vendor xwayland (Phytec Debian Vendor Distribution)"

DISTRO_FEATURES += "x11 wayland vulkan"
```

## conf/distro/phybian-vendor.conf
```bitbake
require phybian.conf

DISTRO = "phybian-vendor-bullseye"
DISTRO_NAME = "phyBIAN Vendor (Phytec Debian Vendor Distribution)"

DISTRO_FEATURES += "pam vendor"

PREFERRED_PROVIDER_virtual/kernel_mx6ul = "linux-imx"
```

## conf/distro/phybian.conf
```bitbake
require conf/distro/debian-bullseye.conf
require common.inc

DISTRO = "phybian-bullseye"
DISTRO_NAME = "phyBIAN (Phytec Debian Distribution)"

DISTRO_FEATURES_DEFAULT_remove = "argp irda pcmcia zeroconf x11"
DISTRO_FEATURES = "${DISTRO_FEATURES_DEFAULT} opengl systemd"
DISTRO_FEATURES_append_mx8 = " qtwidgets"
DISTRO_FEATURES_remove_mx6ul = "opengl"
DISTRO_FEATURES_remove_mx6ul = "wayland"
```

## conf/distro/yogurt-vendor-xwayland.conf
```bitbake
require yogurt-vendor.conf

DISTRO = "yogurt-vendor-xwayland-buster"
DISTRO_NAME = "Yogurt Vendor xwayland (Phytec Vendor Distribution)"

DISTRO_FEATURES += "x11 wayland vulkan"
```

## conf/distro/yogurt-vendor.conf
```bitbake
require yogurt.conf

DISTRO = "yogurt-vendor-buster"
DISTRO_NAME = "Yogurt Vendor (Phytec Vendor Distribution)"

DISTRO_FEATURES += "pam vendor"

PREFERRED_PROVIDER_virtual/kernel_mx6ul = "linux-imx"
```

## conf/distro/yogurt.conf
```bitbake
require conf/distro/debian-buster.conf
require common.inc

DISTRO = "yogurt-buster"
DISTRO_NAME = "Yogurt (Phytec Base Distribution)"

DISTRO_FEATURES_DEFAULT_remove = "argp irda pcmcia zeroconf x11"
DISTRO_FEATURES = "${DISTRO_FEATURES_DEFAULT} opengl systemd"
DISTRO_FEATURES_append_mx8 = " qtwidgets"
DISTRO_FEATURES_remove_mx6ul = "opengl"
```

## conf/layer.conf
```bitbake
# We have a conf and classes directory, append to BBPATH
BBPATH .= ":${LAYERDIR}"

# We have a recipes directory, add to BBFILES
BBFILES += "${LAYERDIR}/recipes*/*/*.bb ${LAYERDIR}/recipes*/*/*.bbappend"

# Layer dependencies
LAYERDEPENDS_yogurt = "isar"
LAYERSERIES_COMPAT_yogurt = "v0.6"
```
